## Documentation/devicetree/bindings/i2c/i2c-hix5hd2.txt
```
I2C for Hisilicon media chipset platforms(3716,3719,3798...)

Required properties :
- compatible : Must be "hisilicon,hix5hd2-i2c"
  Specifically, the following versions of the chipset are supported:
	  Hi3716CV200 (support six I2C module)
	  Hi3719CV100 (support six I2C module)
	  Hi3718CV100 (support six I2C module)
	  Hi3719MV100 (support two I2C module)
	  Hi3718MV100 (support two I2C module)
- reg: physical base address of the controller and length of memory mapped
     region.
- interrupts: interrupt number to the cpu.
- #address-cells = <1>;
- #size-cells = <0>;
- clocks: phandles to input clocks.

Optional properties:
- clock-frequency: Desired I2C bus frequency in Hz, otherwise defaults to 400000
- Child nodes conforming to i2c bus binding

Examples :
I2C0@f8b10000 {
	compatible = "hisilicon,hix5hd2-i2c";
	reg = <0xf8b10000 0x1000>;
	interrupts = <0 38 4>;
	clocks = <&clock HIX5HD2_I2C0_CLK>;
	#address-cells = <1>;
	#size-cells = <0>;
	status = "disabled";
}
```

## Documentation/devicetree/bindings/media/hisi-ir.txt
```
Device-Tree bindings for hisilicon ir IP

Required properties:
	- compatible: Should contain "hisilicon,hix5hd2-ir".
	- reg: Base physical address of the controller and length of memory
	  mapped region.
	- interrupts: interrupt-specifier for the sole interrupt generated by
	  the device. The interrupt specifier format depends on the interrupt
	  controller parent.
	- clocks : phandle with clock-specifier for hisilicon ir.

Example node:

	ir: ir@fe518000 {
		compatible	= "hisilicon, hix5hd2-ir";
		reg		= <0xfe518000 0x234>;
		interrupts	= <0 47 4>;
		clock		= <&clock HIX5HD2_IR_RST>;
	};
```

## Documentation/devicetree/bindings/net/hisilicon,hix5hd2-mdio.txt
```
* Hisilicon HiX5HD2 MDIO Ethernet Controller interface

Required properties:
- compatible: should be "hisilicon,higmac-mdio".
- reg: address and length of the register set for the device.

Example at the SoC level:
mdio@f89403c0 {
	compatible = "hisilicon,higmac-mdio";
	reg = <0xf89403c0 0x14>;
	#address-cells = <1>;
	#size-cells = <0>;
};

And at the board level:

mdio@f89403c0 {
	phy0: ethernet-phy@0 {
		reg = <0>;
	};
};
```

## Documentation/devicetree/bindings/net/hisilicon-hix5hd2-net.txt
```
Hisilicon hix5hd2 Ethernet Controller

Required properties:
- compatible: should be "hisilicon,hix5hd2-mac".
- reg: address and length of the device register and interface register.
- interrupts: interrupt for the device.
- #address-cells: Must be <1>.
- #size-cells: Must be <0>.
- phy-mode: see ethernet.txt [1].
- phy-handle: see ethernet.txt [1].
- mac-address: see ethernet.txt [1].
- clocks: Phandles to input clocks.

- phy subnode: inherits from phy binding [2]

[1] Documentation/devicetree/bindings/net/ethernet.txt
[2] Documentation/devicetree/bindings/net/phy.txt

Example:
	gmac0: ethernet@f9840000 {
		compatible = "hisilicon,hix5hd2-mac";
		reg = <0xf9840000 0x1000>,<0xf984300c 0x4>;
		#address-cells = <1>;
		#size-cells = <0>;
		phy-handle = <&phy0>;
		phy-mode = "mii";
		mac-address = [00 00 00 00 00 00];
		interrupts = <0 71 4>;
		clocks = <&clock HIX5HD2_MAC0_CLK>;

		phy0: ethernet-phy@2 {
			reg = <2>;
			compatible = "ethernet-phy-ieee802.3-c22";
		};
	};
```

## Documentation/devicetree/bindings/phy/hix5hd2-sata-phy.txt
```
Hisilicon hix5hd2 SATA PHY
-----------------------

Required properties:
- compatible : should be "hisilicon,hix5hd2-sata-phy"
- reg : a list of offset + length pairs
- #phy-cells: must be 0
Refer to phy/phy-bindings.txt for the generic PHY binding properties

Optional Properties:
- hisilicon,syscon : phandle of syscon.
- hisilicon,power-reg :offset and bit number of the sata power supply
  register.It's needed when hisilicon,syscon is supplied.
- hisilicon,reg-init : one of more sets of 4 cells.  The first cell
  is the register offset address, the second cell is the start bit in register,
  the third cell means the bit width, and the fourth cell is the value to set.

Example:
	sata_phy: phy@f9900000 {
                        compatible = "hisilicon,hix5hd2-sata-phy";
                        reg = <0xf9900000 0x10000>;
                        #phy-cells = <0>;
			hisilicon,syscon = <&peri_ctrl>;
			hisilicon,power-reg = <0x8 10>;
                        hisilicon,reg-init = <0x148 0 32 0x345cb8>,<0x14c 0 32 0x20545>;
                };
```

## drivers/gpu/drm/hisilicon/Kconfig
```kconfig
config DRM_HIX5HD2
	tristate "DRM Support for Hisilicon HIX5HD2 Soc"
	depends on DRM && (ARM || SUPERH)
	select DRM_KMS_HELPER
	select DRM_KMS_FB_HELPER
	select DRM_KMS_CMA_HELPER
	select DRM_GEM_CMA_HELPER
	help
	  Choose this option if you have an HIX5HD2 chipset.
	  If M is selected the module will be called hix5hd2-drm.
```

## drivers/hisilicon/Kconfig
```kconfig
menu "HIX5HD2 Device Drivers"
	depends on ARCH_HIX5HD2

source "drivers/hisilicon/common/Kconfig"

source "drivers/hisilicon/aiao/Kconfig"

source "drivers/hisilicon/gpu/Kconfig"

source "drivers/hisilicon/hdmi/Kconfig"

source "drivers/hisilicon/hifb/Kconfig"

source "drivers/hisilicon/tde/Kconfig"

source "drivers/hisilicon/pdm/Kconfig"

source "drivers/hisilicon/pq/Kconfig"

source "drivers/hisilicon/omx/Kconfig"

source "drivers/hisilicon/vfmw/Kconfig"

source "drivers/hisilicon/vo/Kconfig"

source "drivers/hisilicon/vpss/Kconfig"

source "drivers/hisilicon/ir/Kconfig"

endmenu
```

## drivers/hisilicon/aiao/Kconfig
```kconfig
menuconfig HI_AIAO_SUPPORT
	tristate  "Audio Input/Output Support"
	default m

if HI_AIAO_SUPPORT
config	HI_SND_ALSA_AO_SUPPORT
	bool "AO ALSA Support"
	default n 

config HI_AI_SUPPORT
	bool "AI Support"
	default n 

config	HI_SND_ALSA_AI_SUPPORT
	depends on HI_AI_SUPPORT
	bool "AI ALSA Support"
	default n 

config	HI_SND_ALSA_I2S_ONLY_SUPPORT
	depends on HI_SND_ALSA_AI_SUPPORT
	bool "ALSA I2S only Card Support"
	default n 

config	HI_SND_ALSA_HDMI_ONLY_SUPPORT
	depends on HI_SND_ALSA_AI_SUPPORT
	bool "ALSA HDMI only Card Support"
	default n 

config HI_SND_CAST_SUPPORT
	bool "AO Cast Support"
	default y

config HI_SND_VIRTUALCHN_SUPPORT
	bool "SND Virtual Channel Support"
	default n

endif
```

## drivers/hisilicon/common/Kconfig
```kconfig
config HI_BASE_SUPPORT
	tristate "Base Support"
	select HI_MMZ_SUPPORT
	select HI_MEDIA_SUPPORT

config HI_MMZ_SUPPORT
	bool "MMZ Support"

config HI_MEDIA_SUPPORT
	bool "HiMedia Support"
```

## drivers/hisilicon/gpu/Kconfig
```kconfig
menuconfig HI_GPU_SUPPORT
	tristate "GPU Support"
	default m

if HI_GPU_SUPPORT
config HI_GPU_DEBUG
        bool "Enable debug in Mali driver"
        ---help---
          This enabled extra debug checks and messages in the Mali driver.

config HI_GPU_PROFILING
        bool "Enable Mali profiling"
        default y
        ---help---
          This enables gator profiling of Mali GPU events.

config HI_GPU_INTERNAL_PROFILING
        bool "Enable internal Mali profiling API"
        depends on HI_GPU_PROFILING
        default n
        ---help---
          This enables the internal legacy Mali profiling API.


config HI_GPU_MAX_SHARE_MEM_SIZE
        hex "Mali400 and OS maximal shared memory size"
        default "0x10000000"
        ---help---
          This constricts the maximal memory GPU could get from os memory.

endif
```

## drivers/hisilicon/hdmi/Kconfig
```kconfig
menuconfig HI_HDMI_SUPPORT
	tristate "HDMI Support"
	default m

if HI_HDMI_SUPPORT
config  HI_HDMI_SUPPORT_HDCP
        bool "HDCP Support"
        help
          If you want to enable HDCP, say y.
        default n

config  HI_HDMI_SUPPORT_CEC
        bool "CEC Support"
        help
          If you want to enable CEC, say y.
        default n
endif
```

## drivers/hisilicon/hifb/Kconfig
```kconfig
menuconfig HI_FRAMEBUFFER_SUPPORT
	tristate "Framebuffer Support"

if HI_FRAMEBUFFER_SUPPORT
config HIFB_CURSOR_SUPPORT
	bool "Cursor in FB Support"
        default n	

config HIFB_COMPRESSION_SUPPORT
	bool "Compression in FB Support"
        default n

config HIFB_SCROLLTEXT_SUPPORT
	bool "Scrolltext in FB Support"
        default n

config HIFB_STEREO3D_SUPPORT
	bool "Hardware Stereo3d Support"
        default y

config HI_HD0_FB_VRAM_SIZE
	int "KB, HD0 FrameBuffer Size"
        default 7200
        help
          For 1280*720, triple buffer, ARGB8888 format, the size is calculated as below:
          (1280*720*4*2/1024)KB

config HI_HD1_FB_VRAM_SIZE
	int "KB, HD1 FrameBuffer Size"
        default 7200
        help
          For 1280*720, triple buffer, ARGB8888 format, the size is calculated as below:
          (1280*720*4*2/1024)KB

config HI_HD2_FB_VRAM_SIZE
	int "KB, HD0 FrameBuffer Size"
        default 7200
        help
          For 1280*720, triple buffer, ARGB8888 format, the size is calculated as below:
          (1280*720*4*2/1024)KB	

config HI_SD0_FB_VRAM_SIZE
	int "KB, SD0 FrameBuffer Size "
        default 3240
        help
          For 720*576, triple buffer, ARGB8888 format, the size is calculated as below:
          (720*576*4*2/1024)KB
endif
```

## drivers/hisilicon/ir/Kconfig
```kconfig
menuconfig HI_IR_SUPPORT
	tristate "IR Support"
	default m

if HI_IR_SUPPORT

endif
```

## drivers/hisilicon/omx/Kconfig
```kconfig
config HI_OMX_SUPPORT
	tristate "Openmax Support"
	default m

if HI_OMX_SUPPORT
	
endif
```

## drivers/hisilicon/tde/Kconfig
```kconfig
menuconfig HI_TDE_SUPPORT
	tristate "TDE Support"
	default m

if HI_TDE_SUPPORT

endif
```

## drivers/hisilicon/vfmw/Kconfig
```kconfig
menuconfig HI_VFMW_SUPPORT
	tristate "Video Decoder Support"
	default m

if HI_VFMW_SUPPORT
	
endif
```

## drivers/hisilicon/vo/Kconfig
```kconfig
menuconfig HI_VDP_SUPPORT
	tristate  "Video Display Support"
	default m

if HI_VDP_SUPPORT
choice
        prompt "Video Buffer Type"
        default HI_VIDEO_BUFF_DEMO
config  HI_VIDEO_BUFF_DEMO
        bool "FMS6141 + FMS6363"
config  HI_VIDEO_BUFF_TYPE0
        bool "FMS6143a + FMS6363"
endchoice

config  HI_DISP_USE_QPLL_SOLELY
        bool "QPLL Be Used By Display Solely"
        help
          If you select true, QPLL should be used by Display solely.
          As a result display can suppport dobuble HD output with different pixel clock.
        default n

config  HI_DISP_TTX_INBUFFERSIZE
        hex "TTX Input Buffer Size"
        help
          You can adjust teletext input buffer size if you need.
        default 0x4000

config  HI_DISP_CC_INBUFFERSIZE
        hex "SD CC Input Buffer Size"
        help
          You can adjust Closed Caption input buffer size if you need.
        default 0x4000

endif
```

## drivers/hisilicon/vpss/Kconfig
```kconfig
menuconfig HI_VPSS_SUPPORT
	tristate "Video Process System Support"
	default m

if HI_VPSS_SUPPORT

config  HI_VPSS_MAX_BUFFER_NUMB
        int "Vpss Port OutBuffer Max  Number(6~20)"
        range 6 20
        default 10
endif
```

## drivers/net/ethernet/hisilicon/Kconfig
```kconfig
#
# HISILICON network device configuration
#

config NET_VENDOR_HISILICON
	bool "Hisilicon devices"
	depends on ARCH_HIX5HD2 
	default y
	---help---
	  If you have a network (Ethernet) card belonging to this class, say Y
	  and read the Ethernet-HOWTO, available from
	  <http://www.tldp.org/docs.html#howto>.

	  Note that the answer to this question doesn't directly affect the
	  kernel: saying N will just cause the configurator to skip all
	  the questions about Hisilicon cards. If you say Y, you will be asked for
	  your specific card in the following questions.

if NET_VENDOR_HISILICON

menuconfig HIETH_GMAC
        tristate "Hisilicon GMAC Family Network Device Support"
        default y
        help
          This selects the hieth gmac family network device.
source "drivers/net/ethernet/hisilicon/hieth-gmac/Kconfig"

endif # NET_VENDOR_HISILICON
```
